## buildroot/configs/viz1090_cm4_disp28_defconfig
```kconfig
# viz1090 Buildroot defconfig
# Target: Raspberry Pi CM4 + Waveshare CM4-DISP-BASE-2.8A (480x640 DPI display)

# Architecture
BR2_aarch64=y
BR2_cortex_a72=y
BR2_ARM_FPU_VFPV4=y

# Toolchain
BR2_TOOLCHAIN_BUILDROOT_GLIBC=y
BR2_TOOLCHAIN_BUILDROOT_CXX=y
BR2_PACKAGE_HOST_GDB=y

# Build options
BR2_CCACHE=y
BR2_GLOBAL_PATCH_DIR="$(BR2_EXTERNAL_VIZ1090_PATH)/patches"

# System configuration
BR2_TARGET_GENERIC_HOSTNAME="viz1090"
BR2_TARGET_GENERIC_ISSUE="viz1090 ADS-B Display"
BR2_INIT_BUSYBOX=y
BR2_SYSTEM_BIN_SH_BUSYBOX=y
BR2_TARGET_GENERIC_GETTY_PORT="tty1"
BR2_TARGET_GENERIC_GETTY_BAUDRATE_115200=y
BR2_TARGET_GENERIC_GETTY_TERM="linux"
BR2_ENABLE_LOCALE_PURGE=y
BR2_ENABLE_LOCALE_WHITELIST="C en_US"
BR2_TARGET_TZ_INFO=y
BR2_TARGET_LOCALTIME="UTC"

# Root filesystem overlay
BR2_ROOTFS_OVERLAY="$(BR2_EXTERNAL_VIZ1090_PATH)/overlay"

# Post-build script
BR2_ROOTFS_POST_BUILD_SCRIPT="$(BR2_EXTERNAL_VIZ1090_PATH)/post-build.sh"

# Kernel
BR2_LINUX_KERNEL=y
BR2_LINUX_KERNEL_CUSTOM_TARBALL=y
BR2_LINUX_KERNEL_CUSTOM_TARBALL_LOCATION="https://github.com/raspberrypi/linux/archive/refs/tags/stable_20231123.tar.gz"
BR2_LINUX_KERNEL_DEFCONFIG="bcm2711"
BR2_LINUX_KERNEL_CONFIG_FRAGMENT_FILES="$(BR2_EXTERNAL_VIZ1090_PATH)/kernel-config-fragment"
BR2_LINUX_KERNEL_DTS_SUPPORT=y
BR2_LINUX_KERNEL_INTREE_DTS_NAME="broadcom/bcm2711-rpi-cm4"
BR2_LINUX_KERNEL_DTB_OVERLAY_SUPPORT=y
BR2_LINUX_KERNEL_NEEDS_HOST_OPENSSL=y

# Bootloader - Raspberry Pi firmware
BR2_PACKAGE_RPI_FIRMWARE=y
BR2_PACKAGE_RPI_FIRMWARE_VARIANT_PI4=y
BR2_PACKAGE_RPI_FIRMWARE_CONFIG_FILE="$(BR2_EXTERNAL_VIZ1090_PATH)/rpi-config.txt"

# Filesystem
BR2_TARGET_ROOTFS_EXT2=y
BR2_TARGET_ROOTFS_EXT2_4=y
BR2_TARGET_ROOTFS_EXT2_SIZE="512M"

# SD card image
BR2_PACKAGE_HOST_GENIMAGE=y
BR2_PACKAGE_HOST_DOSFSTOOLS=y
BR2_PACKAGE_HOST_MTOOLS=y
BR2_ROOTFS_POST_IMAGE_SCRIPT="$(BR2_EXTERNAL_VIZ1090_PATH)/post-image.sh"

# ========================================
# Required packages for viz1090
# ========================================

# Graphics - SDL2
BR2_PACKAGE_SDL2=y
BR2_PACKAGE_SDL2_KMSDRM=y
BR2_PACKAGE_SDL2_OPENGL=y
BR2_PACKAGE_SDL2_OPENGLES=y
BR2_PACKAGE_SDL2_GFX=y
BR2_PACKAGE_SDL2_TTF=y

# Graphics dependencies
BR2_PACKAGE_FREETYPE=y
BR2_PACKAGE_LIBDRM=y
BR2_PACKAGE_MESA3D=y
BR2_PACKAGE_MESA3D_GALLIUM_DRIVER_V3D=y
BR2_PACKAGE_MESA3D_GALLIUM_DRIVER_VC4=y
BR2_PACKAGE_MESA3D_OPENGL_EGL=y
BR2_PACKAGE_MESA3D_OPENGL_ES=y

# libinput for touchscreen
BR2_PACKAGE_LIBINPUT=y
BR2_PACKAGE_LIBEVDEV=y
BR2_PACKAGE_MTDEV=y
BR2_PACKAGE_EUDEV=y

# Networking
BR2_PACKAGE_DHCPCD=y
BR2_PACKAGE_OPENSSH=y
BR2_PACKAGE_DROPBEAR=n

# USB support (for RTL-SDR)
BR2_PACKAGE_LIBUSB=y
BR2_PACKAGE_USBUTILS=y

# RTL-SDR library (for dump1090)
BR2_PACKAGE_RTL_SDR=y

# System utilities
BR2_PACKAGE_BUSYBOX_SHOW_OTHERS=y
BR2_PACKAGE_HTOP=y
BR2_PACKAGE_NANO=y

# Debugging (can be disabled for production)
BR2_PACKAGE_STRACE=y

# ========================================
# Our custom packages
# ========================================
BR2_PACKAGE_DUMP1090=y
BR2_PACKAGE_VIZ1090=y
```

## buildroot/package/dump1090/Config.in
```kconfig
config BR2_PACKAGE_DUMP1090
	bool "dump1090"
	select BR2_PACKAGE_RTL_SDR
	select BR2_PACKAGE_LIBUSB
	help
	  dump1090 - ADS-B Mode S decoder for RTL-SDR devices.

	  Decodes ADS-B messages from aircraft and provides data
	  via Beast protocol on TCP port 30005.

	  Using dump1090-fa (FlightAware fork) for best compatibility.

	  https://github.com/flightaware/dump1090
```

## buildroot/package/viz1090/Config.in
```kconfig
config BR2_PACKAGE_VIZ1090
	bool "viz1090"
	select BR2_PACKAGE_SDL2
	select BR2_PACKAGE_SDL2_GFX
	select BR2_PACKAGE_SDL2_TTF
	select BR2_PACKAGE_FREETYPE
	help
	  viz1090 - ADS-B aircraft visualization application.

	  Displays real-time aircraft positions on an interactive map
	  using data from dump1090.

	  https://github.com/yourusername/viz1090
```
